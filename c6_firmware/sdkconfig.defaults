## c6_firmware/sdkconfig.defaults
```kconfig
# =============================================================================
# sdkconfig.defaults for ESP32-C6 BLE HID Device firmware
# =============================================================================

# --- Target ---
CONFIG_IDF_TARGET="esp32c6"

# --- Flash ---
CONFIG_ESPTOOLPY_FLASHSIZE_4MB=y
CONFIG_ESPTOOLPY_FLASHMODE_QIO=y
CONFIG_ESPTOOLPY_FLASHFREQ_80M=y

# --- Partition Table ---
CONFIG_PARTITION_TABLE_CUSTOM=y
CONFIG_PARTITION_TABLE_CUSTOM_FILENAME="partitions.csv"

# --- FreeRTOS ---
CONFIG_FREERTOS_HZ=1000
CONFIG_FREERTOS_UNICORE=y

# --- Bluetooth (NimBLE) ---
CONFIG_BT_ENABLED=y
CONFIG_BT_NIMBLE_ENABLED=y
CONFIG_BT_NIMBLE_ROLE_PERIPHERAL=y
CONFIG_BT_NIMBLE_ROLE_CENTRAL=n
CONFIG_BT_NIMBLE_ROLE_OBSERVER=n
CONFIG_BT_NIMBLE_ROLE_BROADCASTER=n
CONFIG_BT_NIMBLE_MAX_CONNECTIONS=1
CONFIG_BT_NIMBLE_SVC_GAP_DEVICE_NAME="ESP-HID-Bridge"
CONFIG_BT_NIMBLE_LOG_LEVEL_NONE=n
CONFIG_BT_NIMBLE_LOG_LEVEL_ERROR=y
# Aggressive connection intervals for low latency
CONFIG_BT_NIMBLE_ATT_PREFERRED_MTU=64

# --- Disable Wi-Fi (BLE only mode) ---
CONFIG_ESP_WIFI_ENABLED=n

# --- SDIO Slave ---
CONFIG_SDIO_SLAVE_ISR_IN_IRAM=y

# --- Logging ---
CONFIG_LOG_DEFAULT_LEVEL_INFO=y

# --- Stack Sizes ---
CONFIG_ESP_MAIN_TASK_STACK_SIZE=6144

# --- Watchdog ---
CONFIG_ESP_TASK_WDT_EN=y
CONFIG_ESP_TASK_WDT_TIMEOUT_S=10
```

## p4_firmware/sdkconfig.defaults
```kconfig
# =============================================================================
# sdkconfig.defaults for ESP32-P4 USB-to-BLE/Wi-Fi Bridge
# =============================================================================

# --- Target ---
CONFIG_IDF_TARGET="esp32p4"

# --- Silicon Revision (Early Silicon v0.1 / v1.0) ---
CONFIG_ESP32P4_SELECTS_REV_LESS_V3=y
CONFIG_ESP32P4_REV_MIN_0=y

# --- System / CPU ---
CONFIG_ESP_DEFAULT_CPU_FREQ_MHZ_360=y
CONFIG_XTAL_FREQ_40=y
CONFIG_ESP_SYSTEM_SINGLE_CORE_MODE=n

# --- Flash & PSRAM ---
CONFIG_ESPTOOLPY_FLASHSIZE_16MB=y
CONFIG_ESPTOOLPY_FLASHMODE_QIO=y
CONFIG_ESPTOOLPY_FLASHFREQ_80M=y
CONFIG_SPIRAM=y
CONFIG_SPIRAM_MODE_OCT=y
CONFIG_SPIRAM_SPEED_80M=y
CONFIG_SPIRAM_MALLOC_ALWAYSINTERNAL=16384

# --- Partition Table ---
CONFIG_PARTITION_TABLE_CUSTOM=y
CONFIG_PARTITION_TABLE_CUSTOM_FILENAME="partitions.csv"

# --- FreeRTOS ---
CONFIG_FREERTOS_HZ=1000
CONFIG_FREERTOS_UNICORE=n

# --- USB Host ---
CONFIG_USB_HOST_ENABLE_ENUM_FILTER_CALLBACK=y
CONFIG_USB_HOST_CONTROL_TRANSFER_MAX_SIZE=512

# --- Wi-Fi Remote (routes standard esp_wifi calls to C6 over SDIO) ---
CONFIG_ESP_WIFI_REMOTE_ENABLED=y
CONFIG_SLAVE_IDF_TARGET_ESP32C6=y
CONFIG_ESP_WIFI_REMOTE_LIBRARY_HOSTED=y

# --- ESP-Hosted Configuration ---
CONFIG_ESP_HOSTED_ENABLED=y
CONFIG_ESP_HOSTED_CP_TARGET_ESP32C6=y
CONFIG_ESP_HOSTED_SDIO_HOST_INTERFACE=y
CONFIG_ESP_HOSTED_SDIO_4_BIT_BUS=y
CONFIG_ESP_HOSTED_SDIO_SLOT_1=y
CONFIG_ESP_HOSTED_SDIO_CLOCK_FREQ_KHZ=40000
CONFIG_ESP_HOSTED_PRIV_SDIO_PIN_CMD_SLOT_1=19
CONFIG_ESP_HOSTED_PRIV_SDIO_PIN_CLK_SLOT_1=18
CONFIG_ESP_HOSTED_PRIV_SDIO_PIN_D0_SLOT_1=14
CONFIG_ESP_HOSTED_PRIV_SDIO_PIN_D1_4BIT_BUS_SLOT_1=15
CONFIG_ESP_HOSTED_PRIV_SDIO_PIN_D2_4BIT_BUS_SLOT_1=16
CONFIG_ESP_HOSTED_PRIV_SDIO_PIN_D3_4BIT_BUS_SLOT_1=17
CONFIG_ESP_HOSTED_SDIO_PIN_CMD=19
CONFIG_ESP_HOSTED_SDIO_PIN_CLK=18
CONFIG_ESP_HOSTED_SDIO_PIN_D0=14
CONFIG_ESP_HOSTED_SDIO_PIN_D1=15
CONFIG_ESP_HOSTED_SDIO_PIN_D2=16
CONFIG_ESP_HOSTED_SDIO_PIN_D3=17
CONFIG_ESP_HOSTED_SDIO_GPIO_RESET_SLAVE=54
CONFIG_ESP_HOSTED_GPIO_SLAVE_RESET_SLAVE=54
CONFIG_ESP_HOSTED_SLAVE_RESET_ON_EVERY_HOST_BOOTUP=y

# --- Bluetooth (NimBLE over ESP-Hosted) ---
CONFIG_BT_ENABLED=y
CONFIG_BT_CONTROLLER_DISABLED=y
CONFIG_BT_BLUEDROID_ENABLED=n
CONFIG_BT_NIMBLE_ENABLED=y
CONFIG_BT_NIMBLE_TRANSPORT_UART=n
CONFIG_BT_NIMBLE_ROLE_PERIPHERAL=y
CONFIG_BT_NIMBLE_ROLE_CENTRAL=n
CONFIG_BT_NIMBLE_ROLE_BROADCASTER=n
CONFIG_BT_NIMBLE_ROLE_OBSERVER=n
CONFIG_BT_NIMBLE_MAX_CONNECTIONS=1
CONFIG_BT_NIMBLE_SVC_GAP_DEVICE_NAME="ESP-HID-Bridge"
CONFIG_BT_NIMBLE_ATT_PREFERRED_MTU=64
CONFIG_ESP_HOSTED_ENABLE_BT_NIMBLE=y
CONFIG_ESP_HOSTED_NIMBLE_HCI_VHCI=y

# --- Logging ---
CONFIG_LOG_DEFAULT_LEVEL_INFO=y
CONFIG_LOG_MAXIMUM_LEVEL_DEBUG=y

# --- Stack Sizes ---
CONFIG_ESP_MAIN_TASK_STACK_SIZE=8192
CONFIG_ESP_TASK_WDT_EN=y
CONFIG_ESP_TASK_WDT_TIMEOUT_S=10
```
